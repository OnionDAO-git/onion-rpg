## beacon/sdkconfig.defaults
```kconfig
# ONION RPG beacon sdkconfig.defaults
# Target: ESP32-C3 (single-core RISC-V, 4 MB flash, 400 KB SRAM)
#
# These are base defaults. Local overrides (sdkconfig.local, not committed)
# or the build system can override any of these.

# ── Target ─────────────────────────────────────────────────────────────
CONFIG_IDF_TARGET="esp32c3"

# ── Flash / partition ───────────────────────────────────────────────────
CONFIG_ESPTOOLPY_FLASHSIZE_4MB=y
CONFIG_PARTITION_TABLE_CUSTOM=y
CONFIG_PARTITION_TABLE_CUSTOM_FILENAME="partitions/partitions.csv"

# ── FreeRTOS ────────────────────────────────────────────────────────────
CONFIG_FREERTOS_HZ=100
CONFIG_FREERTOS_TASK_NOTIFICATION_ARRAY_ENTRIES=3

# ── WiFi ────────────────────────────────────────────────────────────────
CONFIG_ESP_WIFI_STATIC_RX_BUFFER_NUM=10
CONFIG_ESP_WIFI_DYNAMIC_RX_BUFFER_NUM=32
CONFIG_ESP_WIFI_TX_BUFFER=DYNAMIC
CONFIG_ESP_WIFI_DYNAMIC_TX_BUFFER_NUM=32
CONFIG_ESP_WIFI_IRAM_OPT=y
CONFIG_ESP_WIFI_RX_IRAM_OPT=y
# ESP-NOW requires promiscuous-mode RX when not in STA-AP mode
CONFIG_ESP_WIFI_ESPNOW_MAX_ENCRYPT_NUM=6

# ── ESP-NOW ─────────────────────────────────────────────────────────────
CONFIG_ESP_WIFI_ESP_NOW_MAX_PEERS=20

# ── HTTP / TLS ──────────────────────────────────────────────────────────
CONFIG_ESP_HTTP_CLIENT_ENABLE_HTTPS=y
CONFIG_ESP_TLS_SERVER_SESSION_TICKETS=n
CONFIG_MBEDTLS_CERTIFICATE_BUNDLE=y
CONFIG_MBEDTLS_CERTIFICATE_BUNDLE_DEFAULT_FULL=y

# ── Logging ─────────────────────────────────────────────────────────────
CONFIG_LOG_DEFAULT_LEVEL_INFO=y
# Set to DEBUG for field diagnostics:
# CONFIG_LOG_DEFAULT_LEVEL_DEBUG=y

# ── SPIFFS ──────────────────────────────────────────────────────────────
CONFIG_SPIFFS_MAX_PARTITIONS=1
CONFIG_SPIFFS_USE_MAGIC=y

# ── NVS ─────────────────────────────────────────────────────────────────
CONFIG_NVS_ENCRYPTION=n

# ── Stack / heap ────────────────────────────────────────────────────────
CONFIG_ESP_MAIN_TASK_STACK_SIZE=4096
CONFIG_ESP_SYSTEM_EVENT_TASK_STACK_SIZE=4096

# ── OTA ─────────────────────────────────────────────────────────────────
CONFIG_OTA_ALLOW_HTTP=n

# ── Compiler ────────────────────────────────────────────────────────────
CONFIG_COMPILER_OPTIMIZATION_SIZE=y
CONFIG_COMPILER_WARN_WRITE_STRINGS=y
```
